## boards/shields/cirque_trackpad/Kconfig.defconfig
```kconfig
# Copyright (c) 2026 The ZMK Contributors
# SPDX-License-Identifier: MIT

if SHIELD_CIRQUE_TRACKPAD

config INPUT
    default y

config INPUT_PINNACLE
    default y

config SPI
    default y

config ZMK_POINTING
    default y

endif # SHIELD_CIRQUE_TRACKPAD
```

## boards/shields/cirque_trackpad/Kconfig.shield
```kconfig
# Copyright (c) 2026 The ZMK Contributors
# SPDX-License-Identifier: MIT

config SHIELD_CIRQUE_TRACKPAD
    def_bool $(shields_list_contains,cirque_trackpad)
```

## config/west.yml
```yaml
manifest:
  remotes:
    - name: zmkfirmware
      url-base: https://github.com/zmkfirmware
    - name: MickiusMousius
      url-base: https://github.com/MickiusMousius
    - name: elpekenin
      url-base: https://github.com/elpekenin
  projects:
    - name: zmk
      import: app/west.yml
      remote: zmkfirmware
      revision: main
    - name: zmk-userspace
      remote: elpekenin
      revision: main
    - name: zmk-patch-batterylevel
      remote: MickiusMousius
      revision: main
    - name: zmk-patch-ec11
      remote: MickiusMousius
      revision: main
  self:
    path: config
```
