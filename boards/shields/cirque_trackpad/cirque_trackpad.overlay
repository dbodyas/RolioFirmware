/*
 * Copyright (c) 2026 The ZMK Contributors
 * SPDX-License-Identifier: MIT
 */

#include <input/processors.dtsi>
#include <dt-bindings/zmk/input_transform.h>

&spi0 {
    status = "okay";

    glidepoint: glidepoint@0 {
        compatible = "cirque,pinnacle";
        reg = <0>;
        spi-max-frequency = <1000000>;
        status = "okay";
        data-ready-gpios = <&gpio1 6 GPIO_ACTIVE_HIGH>;
        sensitivity = "2x";
        sleep-mode-enable;
    };
};

&glidepoint_split {
    device = <&glidepoint>;
    input-processors = <&zip_xy_transform (INPUT_TRANSFORM_Y_INVERT)>;
};
